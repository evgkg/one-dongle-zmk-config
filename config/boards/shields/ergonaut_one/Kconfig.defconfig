## config/boards/shields/ergonaut_one/Kconfig.defconfig
```kconfig
# Copyright (c) 2020 The ZMK Contributors
# SPDX-License-Identifier: MIT

if SHIELD_ERGONAUT_ONE_DONGLE

config ZMK_KEYBOARD_NAME
    default "Ergonaut One"

config ZMK_SPLIT_ROLE_CENTRAL
    default y

config ZMK_SPLIT_BLE_CENTRAL_PERIPHERALS
    default 2

config BT_MAX_CONN
    default 7

config BT_MAX_PAIRED
    default 7

config USB_HID_POLL_INTERVAL_MS
    default 1

endif

if SHIELD_ERGONAUT_ONE_LEFT || SHIELD_ERGONAUT_ONE_RIGHT || SHIELD_ERGONAUT_ONE_DONGLE

config ZMK_SPLIT
    default y

endif
```
